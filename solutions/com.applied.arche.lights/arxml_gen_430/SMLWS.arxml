AUTOSAR XML (schema 00044)
standard types defined: boolean, float32, float64, sint16, sint32, sint64, sint8, uint16, uint32, uint64, uint8
package /AUTOSAR_Platform/CompuMethods
  compu method CompuMethod_boolean: 0=FALSE, 1=TRUE
package /AUTOSAR_Platform/DataConstrs
  range DataConstr_boolean: raw 0..1
  range DataConstr_float32: raw -3.4028235e+38..3.4028235e+38
  range DataConstr_float64: raw -1.7976931348623157e+308..1.7976931348623157e+308
  range DataConstr_sint16: raw -32768..32767
  range DataConstr_sint32: raw -2147483648..2147483647
  range DataConstr_sint64: raw -9223372036854775808..9223372036854775807
  range DataConstr_sint8: raw -128..127
  range DataConstr_uint16: raw 0..65535
  range DataConstr_uint32: raw 0..4294967295
  range DataConstr_uint64: raw 0..18446744073709551615
  range DataConstr_uint8: raw 0..255
package /VW/Global/PhysicalDimensions
  physical dimension PD_undefined_unit_helper_nounit
package /VW/Global/Units
  unit Unit_nounit: display-name=nounit, factor-si-to-unit=1.0, offset-si-to-unit=0, physical-dimension=PD_undefined_unit_helper_nounit
package /com/applied/arche/lights/ApplicationDataTypes
  app type ADT_boolean: category=BOOLEAN, compu {0=FALSE, 1=TRUE}
package /com/applied/arche/lights/BaseTypes
  base type BT_StalkControl_X_hazard_triggered: category=FIXED_LENGTH, base-type-size=8, base-type-encoding=NONE
package /com/applied/arche/lights/CommunicationClusters
  can cluster can1_front_exterior: baudrate=500000, protocol-name=CAN, protocol-version=2.0, can-fd-baudrate=0
    can physical channel CHNL: comm-connectors=CN_can1_front_exterior
      frame HazardLightsReq_XIX_can1_front_exterior: id 0xB5, from SMLWS, frame-length=8, can-addressing-mode=STANDARD, can-frame-rx-behavior=CAN-FD, can-frame-tx-behavior=CAN-FD
        pdu HazardLightsReq_XIX_can1_front_exterior: length=8, transmission-mode-true-timing=cyclic-timing={time-offset=0, time-period=0.0}, unused-bit-pattern=0
          signal StalkControl_X_hazard_triggered_XIX_HazardLightsReq_XIX_can1_front_exterior: start 38, 1 bit, little-endian, data-type-policy=OVERRIDE, i-signal-type=PRIMITIVE, init-value=0, base-type=BT_StalkControl_X_hazard_triggered, invalid-value=Invalid_StalkControl_X_hazard_triggered_XIX_HazardLightsReq_XIX_can1_front_exterior:1, compu {phys=raw for raw 0..1}, range phys 0..1, raw 0..1, transfer-property=PENDING
package /com/applied/arche/lights/ConstantSpecifications
  constant specification C_INIT_ADT_StalkControl_hazard_triggered: value-spec=0
package /com/applied/arche/lights/EcuInstances
  ecu instance SMLWS: associated-com-i-pdu-group=SMLWS_XIX_can1_front_exterior_Tx, pn-reset-time=0.5, pnc-prepare-sleep-timer=0, sleep-mode-supported=true, wake-up-over-bus-supported=false
    can communication controller CT_can1_front_exterior: wake-up-by-controller-supported=true
    can communication connector CN_can1_front_exterior: comm-controller=CT_can1_front_exterior, pnc-gateway-type=NONE
package /com/applied/arche/lights/ISignaliPduGroup
  i signal i pdu group SMLWS_XIX_can1_front_exterior_Tx: communication-direction=OUT, communication-mode=CAN_Transmit_All, i-signal-i-pdus=HazardLightsReq_XIX_can1_front_exterior
package /com/applied/arche/lights/PortInterfaces
  sender receiver interface ADT_StalkControl
    data hazard_triggered
package /com/applied/arche/lights/SwComponentTypes
  composition sw component type Communication_Cluster_root_composition
    provide port PP_SMLWS_StalkControl: nonqueued-sender-com-spec{data-element=hazard_triggered, init-value=constant-reference=C_INIT_ADT_StalkControl_hazard_triggered}, provided-interface=ADT_StalkControl
    component I_FrontHazardIntent: type=FrontHazardIntent
    delegate I_FrontHazardIntent.PP_StalkControl <-> outer port PP_SMLWS_StalkControl
  composition sw component type FrontHazardIntent
    provide port PP_StalkControl: nonqueued-sender-com-spec{data-element=hazard_triggered, init-value=constant-reference=C_INIT_ADT_StalkControl_hazard_triggered}, provided-interface=ADT_StalkControl
package /com/applied/arche/lights/Systems
  system SYSTEM: category=ECU_EXTRACT, pnc-vector-length=0, pnc-vector-offset=0
    system mapping Communication_Cluster_Mappings: sender-receiver-to-signal-mapping{communication-direction=OUT, data-element=I_FrontHazardIntent.Communication_Cluster_root_composition.PP_StalkControl.hazard_triggered, system-signal=StalkControl_X_hazard_triggered}
      sw-mappings:
        swc to ecu mapping MAPPING_FrontHazardIntent: component=Communication_Cluster_root_composition.I_FrontHazardIntent, ecu-instance=SMLWS
    root-software-compositions:
      root sw composition prototype Communication_Cluster_root_composition: software-composition=Communication_Cluster_root_composition
