AUTOSAR XML (schema 00044)
standard types defined: boolean, float32, float64, sint16, sint32, sint64, sint8, uint16, uint32, uint64, uint8
package /AUTOSAR_Platform/CompuMethods
  compu method CompuMethod_boolean: 0=FALSE, 1=TRUE
package /AUTOSAR_Platform/DataConstrs
  range DataConstr_boolean: raw 0..1
  range DataConstr_float32: raw -3.4028235e+38..3.4028235e+38
  range DataConstr_float64: raw -1.7976931348623157e+308..1.7976931348623157e+308
  range DataConstr_sint16: raw -32768..32767
  range DataConstr_sint32: raw -2147483648..2147483647
  range DataConstr_sint64: raw -9223372036854775808..9223372036854775807
  range DataConstr_sint8: raw -128..127
  range DataConstr_uint16: raw 0..65535
  range DataConstr_uint32: raw 0..4294967295
  range DataConstr_uint64: raw 0..18446744073709551615
  range DataConstr_uint8: raw 0..255
package /VW/Global/PhysicalDimensions
  physical dimension PD_undefined_unit_helper_nounit
package /VW/Global/Units
  unit Unit_nounit: display-name=nounit, factor-si-to-unit=1.0, offset-si-to-unit=0, physical-dimension=PD_undefined_unit_helper_nounit
package /com/applied/arche/lights/ApplicationDataTypes
  app type ADT_boolean: category=BOOLEAN, compu {0=FALSE, 1=TRUE}
package /com/applied/arche/lights/BaseTypes
  base type BT_RightHazardOutSignal_X_DE_ALU_R_440_PWM: category=FIXED_LENGTH, base-type-size=8, base-type-encoding=NONE
package /com/applied/arche/lights/CommunicationClusters
  can cluster can3_front_exterior: baudrate=500000, protocol-name=CAN, protocol-version=2.0, can-fd-baudrate=0
    can physical channel CHNL: comm-connectors=CN_can3_front_exterior
      frame RightHazardOut_XIX_can3_front_exterior: id 0x1C7, to LSG_R, frame-length=64, can-addressing-mode=STANDARD, can-frame-rx-behavior=CAN-FD, can-frame-tx-behavior=CAN-FD
        pdu RightHazardOut_XIX_can3_front_exterior: length=64, transmission-mode-true-timing=cyclic-timing={time-offset=0, time-period=0.0}, unused-bit-pattern=0
          signal RightHazardOutSignal_X_DE_ALU_R_440_PWM_XIX_RightHazardOut_XIX_can3_front_exterior: start 336, 8 bit, little-endian, data-type-policy=OVERRIDE, i-signal-type=PRIMITIVE, init-value=0, base-type=BT_RightHazardOutSignal_X_DE_ALU_R_440_PWM, invalid-value=Invalid_RightHazardOutSignal_X_DE_ALU_R_440_PWM_XIX_RightHazardOut_XIX_can3_front_exterior:1, compu {phys=raw for raw 0..255}, range phys 0..255, raw 0..255, transfer-property=PENDING, to LSG_R
package /com/applied/arche/lights/EcuInstances
  ecu instance LSG_R: associated-com-i-pdu-group=LSG_R_XIX_can3_front_exterior_Rx, pn-reset-time=0.5, pnc-prepare-sleep-timer=0, sleep-mode-supported=true, wake-up-over-bus-supported=false
    can communication controller CT_can3_front_exterior: wake-up-by-controller-supported=true
    can communication connector CN_can3_front_exterior: comm-controller=CT_can3_front_exterior, pnc-gateway-type=NONE
package /com/applied/arche/lights/ISignaliPduGroup
  i signal i pdu group LSG_R_XIX_can3_front_exterior_Rx: communication-direction=IN, communication-mode=CAN_Receive_All, i-signal-i-pdus=RightHazardOut_XIX_can3_front_exterior
package /com/applied/arche/lights/Systems
  system SYSTEM: category=ECU_EXTRACT, pnc-vector-length=0, pnc-vector-offset=0
    system mapping VehicleCommunicationCluster_Mappings
